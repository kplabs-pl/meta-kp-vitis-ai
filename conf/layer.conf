## conf/layer.conf
```bitbake
# We have a conf and classes directory, add to BBPATH
BBPATH .= ":${LAYERDIR}"

# We have recipes-* directories, add to BBFILES
BBFILES += "${LAYERDIR}/recipes-*/*/*.bb \
            ${LAYERDIR}/recipes-*/*/*.bbappend"

BBFILE_COLLECTIONS += "meta-kp-vitis-ai"
BBFILE_PATTERN_meta-kp-vitis-ai = "^${LAYERDIR}/"
BBFILE_PRIORITY_meta-kp-vitis-ai = "6"

LAYERDEPENDS_meta-kp-vitis-ai = "core"
LAYERSERIES_COMPAT_meta-kp-vitis-ai = "nanbield"
```
